## components/c6_rf_test/Kconfig
```kconfig
menu "C6 RF Coexistence Test"

config C6_RF_TEST_ENABLED
    bool "Enable C6 RF coexistence test framework (P4 host side)"
    default n
    help
        Compile the c6_rf_test component's active implementation.
        Keep n for the factory firmware; enable explicitly in CI as a
        compile gate and on-device during the flashing window.

config C6_RF_TEST_ENABLE_BLE
    bool "Include BLE scan test path"
    depends on C6_RF_TEST_ENABLED
    default n
    help
        Requires esp_hosted >= 2.x with host BT feature
        (CONFIG_ESP_HOSTED_HOST_FEAT_BT) and a rebuilt C6 coprocessor
        firmware with CONFIG_ESP_HOSTED_CP_FEAT_BT — do in the flashing
        window only.

endmenu
```

## components/sys_net/Kconfig
```kconfig
menu "sys_net"

config SYS_NET_ESPNOW_ENABLE
    bool "Enable ESP-NOW peer discovery"
    default n
    help
        ESP-NOW 邻居发现 (每秒广播本机名, 5s TTL 邻居表)。

        当前 ESP-Hosted (P4 + C6 协处理器) 链路的 esp_wifi_remote
        只注入 esp_now.h 头文件, 没有提供主机端 esp_now_* 实现,
        打开本选项会在链接期报 undefined reference。等 esp_wifi_remote
        正式支持 hosted ESP-NOW 后再开启; 关闭时接口返回
        ESP_ERR_NOT_SUPPORTED, UI 上开关会自动弹回。

endmenu
```
